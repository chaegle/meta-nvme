## conf/layer.conf
```bitbake
# We have a conf and classes directory, add to BBPATH
BBPATH .= ":${LAYERDIR}"

# We have recipes-* directories, add to BBFILES
BBFILES += "${LAYERDIR}/recipes-*/*/*.bb \
            ${LAYERDIR}/recipes-*/*/*.bbappend"

BBFILE_COLLECTIONS += "meta-nvme"
BBFILE_PATTERN_meta-nvme = "^${LAYERDIR}/"
BBFILE_PRIORITY_meta-nvme = "6"

LAYERDEPENDS_meta-nvme = "core"
LAYERSERIES_COMPAT_meta-nvme = "zeus gatesgarth"
```
